## sdkconfig.defaults
```kconfig
# 目标芯片: ESP32-S3 (ESP32-S3-DevKitC-1-N16R8)
CONFIG_IDF_TARGET="esp32s3"

# 双核 FreeRTOS
CONFIG_FREERTOS_UNICORE=n

# 日志级别
CONFIG_LOG_DEFAULT_LEVEL_INFO=y

# UART 驱动
CONFIG_UART_ISR_IN_IRAM=y

# SPI
CONFIG_SPI_MASTER_IN_IRAM=y

# 主频 240MHz
CONFIG_ESP32S3_DEFAULT_CPU_FREQ_240=y

# Flash: 16MB Octal SPI (N16)
# 注意: GPIO26~GPIO37 被 Octal Flash/PSRAM 占用，不可作普通 GPIO
CONFIG_ESPTOOLPY_FLASHSIZE_16MB=y
CONFIG_ESPTOOLPY_OCT_FLASH=y

# PSRAM: 8MB Octal SPI (R8)
CONFIG_SPIRAM=y
CONFIG_SPIRAM_MODE_OCT=y
CONFIG_SPIRAM_SPEED_80M=y
```

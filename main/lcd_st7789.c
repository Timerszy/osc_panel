#include "lcd_st7789.h"
#include "pin_config.h"
#include "esp_log.h"
#include "driver/gpio.h"
#include "driver/spi_master.h"
#include "freertos/FreeRTOS.h"
#include "freertos/task.h"
#include "esp_heap_caps.h"
#include <string.h>

static const char *TAG = "LCD";

/* ─── ST7789 命令宏 ─── */
#define ST7789_SWRESET  0x01
#define ST7789_SLPOUT   0x11
#define ST7789_NORON    0x13
#define ST7789_INVON    0x21
#define ST7789_DISPON   0x29
#define ST7789_CASET    0x2A
#define ST7789_RASET    0x2B
#define ST7789_RAMWR    0x2C
#define ST7789_MADCTL   0x36
#define ST7789_COLMOD   0x3A

/* ─── 6×8 像素 ASCII 字体 (列主序, 位0=顶行) ─── */
static const uint8_t s_font6x8[][6] = {
    {0x00,0x00,0x00,0x00,0x00,0x00}, /* 0x20 ' ' */
    {0x00,0x00,0x5F,0x00,0x00,0x00}, /* 0x21 '!' */
    {0x00,0x07,0x00,0x07,0x00,0x00}, /* 0x22 '"' */
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    {0x10,0x08,0x08,0x10,0x08,0x00}, /* 0x7E '~' */
};

/* ─── SPI 句柄 ─── */
static spi_device_handle_t s_spi;

/* ─── 帧缓冲区 (PSRAM, 存储字节序已交换为 SPI big-endian) ─── */
#define FB_PIXELS (LCD_WIDTH * LCD_HEIGHT)
static uint16_t *s_fb;

static inline uint16_t swap16(uint16_t c)
{
    return (c >> 8) | (c << 8);
}

/* ─── DC 引脚由 pre_transfer 回调控制 ─── */
static void IRAM_ATTR lcd_spi_pre_cb(spi_transaction_t *t)
{
    gpio_set_level(LCD_PIN_DC, (int)t->user);
}

/* ─── 发送命令 ─── */
static void lcd_cmd(uint8_t cmd)
{
    spi_transaction_t t = {
        .length = 8,
        .tx_data = {cmd},
        .flags = SPI_TRANS_USE_TXDATA,
        .user  = (void *)0,  // DC=0 => 命令
    };
    spi_device_polling_transmit(s_spi, &t);
}

/* ─── 发送数据字节 ─── */
static void lcd_data_byte(uint8_t data)
{
    spi_transaction_t t = {
        .length = 8,
        .tx_data = {data},
        .flags = SPI_TRANS_USE_TXDATA,
        .user  = (void *)1,  // DC=1 => 数据
    };
    spi_device_polling_transmit(s_spi, &t);
}

/* ─── 发送数据缓冲区 ─── */
static void lcd_data_buf(const uint8_t *buf, size_t len)
{
    if (len == 0) return;
    spi_transaction_t t = {
        .length    = len * 8,
        .tx_buffer = buf,
        .user      = (void *)1,
    };
    spi_device_polling_transmit(s_spi, &t);
}

/* ─── 设置绘制窗口 ─── */
static void lcd_set_window(uint16_t x0, uint16_t y0, uint16_t x1, uint16_t y1)
{
    lcd_cmd(ST7789_CASET);
    uint8_t col[4] = {x0 >> 8, x0 & 0xFF, x1 >> 8, x1 & 0xFF};
    lcd_data_buf(col, 4);

    lcd_cmd(ST7789_RASET);
    uint8_t row[4] = {y0 >> 8, y0 & 0xFF, y1 >> 8, y1 & 0xFF};
    lcd_data_buf(row, 4);

    lcd_cmd(ST7789_RAMWR);
}

/* ─── 公开接口 ─── */

void lcd_init(void)
{
    /* 0. 分配帧缓冲区 (优先 PSRAM, 回退内部 SRAM) */
    s_fb = heap_caps_malloc(FB_PIXELS * sizeof(uint16_t), MALLOC_CAP_SPIRAM | MALLOC_CAP_8BIT);
    if (!s_fb) {
        s_fb = heap_caps_malloc(FB_PIXELS * sizeof(uint16_t), MALLOC_CAP_DMA | MALLOC_CAP_8BIT);
    }
    assert(s_fb);

    /* 1. SPI 总线 */
    spi_bus_config_t bus_cfg = {
        .mosi_io_num   = LCD_PIN_MOSI,
        .miso_io_num   = -1,
        .sclk_io_num   = LCD_PIN_SCLK,
        .quadwp_io_num = -1,
        .quadhd_io_num = -1,
        .max_transfer_sz = FB_PIXELS * 2,
    };
    spi_bus_initialize(LCD_SPI_HOST, &bus_cfg, SPI_DMA_CH_AUTO);

    /* 2. 注册 LCD 设备 */
    spi_device_interface_config_t dev_cfg = {
        .clock_speed_hz = LCD_SPI_FREQ_HZ,
        .mode           = 3,              // ST7789: CPOL=1, CPHA=1
        .spics_io_num   = LCD_PIN_CS,
        .queue_size     = 7,
        .pre_cb         = lcd_spi_pre_cb,
    };
    spi_bus_add_device(LCD_SPI_HOST, &dev_cfg, &s_spi);

    /* 3. DC / RST / BL 引脚 */
    gpio_config_t io_cfg = {
        .mode         = GPIO_MODE_OUTPUT,
        .pull_up_en   = GPIO_PULLUP_DISABLE,
        .pull_down_en = GPIO_PULLDOWN_DISABLE,
        .intr_type    = GPIO_INTR_DISABLE,
        .pin_bit_mask = (1ULL << LCD_PIN_DC)  |
                        (1ULL << LCD_PIN_RST) |
                        (1ULL << LCD_PIN_BL),
    };
    gpio_config(&io_cfg);

    /* 4. 硬件复位 */
    gpio_set_level(LCD_PIN_BL,  0);
    gpio_set_level(LCD_PIN_RST, 0);
    vTaskDelay(pdMS_TO_TICKS(10));
    gpio_set_level(LCD_PIN_RST, 1);
    vTaskDelay(pdMS_TO_TICKS(120));

    /* 5. ST7789 初始化序列 */
    lcd_cmd(ST7789_SWRESET);
    vTaskDelay(pdMS_TO_TICKS(150));

    lcd_cmd(ST7789_SLPOUT);
    vTaskDelay(pdMS_TO_TICKS(10));

    lcd_cmd(ST7789_COLMOD);
    lcd_data_byte(0x55);           // 16位色 RGB565
    vTaskDelay(pdMS_TO_TICKS(10));

    lcd_cmd(ST7789_MADCTL);
    lcd_data_byte(0x00);           // 正向, RGB

    lcd_cmd(ST7789_INVON);         // 颜色反转 (部分屏需要)

    lcd_cmd(ST7789_NORON);
    vTaskDelay(pdMS_TO_TICKS(10));

    lcd_cmd(ST7789_DISPON);
    vTaskDelay(pdMS_TO_TICKS(10));

    /* 6. 背光开 */
    gpio_set_level(LCD_PIN_BL, 1);

    lcd_fill(LCD_BLACK);
    lcd_flush();
    ESP_LOGI(TAG, "ST7789 initialized (%dx%d, framebuffer=%s)",
             LCD_WIDTH, LCD_HEIGHT,
             esp_ptr_external_ram(s_fb) ? "PSRAM" : "SRAM");
}

void lcd_fill_rect(uint16_t x, uint16_t y, uint16_t w, uint16_t h, uint16_t color)
{
    if (w == 0 || h == 0) return;
    uint16_t xe = x + w, ye = y + h;
    if (xe > LCD_WIDTH)  xe = LCD_WIDTH;
    if (ye > LCD_HEIGHT) ye = LCD_HEIGHT;
    uint16_t sc = swap16(color);
    for (uint16_t r = y; r < ye; r++) {
        uint16_t *row = &s_fb[r * LCD_WIDTH];
        for (uint16_t c = x; c < xe; c++) {
            row[c] = sc;
        }
    }
}

void lcd_fill(uint16_t color)
{
    if (color == 0x0000) {
        memset(s_fb, 0, FB_PIXELS * sizeof(uint16_t));
    } else {
        uint16_t sc = swap16(color);
        for (int i = 0; i < FB_PIXELS; i++) s_fb[i] = sc;
    }
}

void lcd_draw_char(uint16_t x, uint16_t y, char ch,
                   uint16_t fg, uint16_t bg, uint8_t scale)
{
    if (ch < 0x20 || ch > 0x7E) ch = '?';
    const uint8_t *glyph = s_font6x8[(uint8_t)(ch - 0x20)];
    uint16_t sfg = swap16(fg), sbg = swap16(bg);

    for (uint8_t col = 0; col < 6; col++) {
        uint8_t col_data = glyph[col];
        for (uint8_t row = 0; row < 8; row++) {
            uint16_t sc = (col_data & (1 << row)) ? sfg : sbg;
            if (scale == 1) {
                uint16_t px = x + col, py = y + row;
                if (px < LCD_WIDTH && py < LCD_HEIGHT)
                    s_fb[py * LCD_WIDTH + px] = sc;
            } else {
                uint16_t px = x + col * scale;
                uint16_t py = y + row * scale;
                for (uint8_t sy = 0; sy < scale; sy++)
                    for (uint8_t sx = 0; sx < scale; sx++)
                        if (px + sx < LCD_WIDTH && py + sy < LCD_HEIGHT)
                            s_fb[(py + sy) * LCD_WIDTH + (px + sx)] = sc;
            }
        }
    }
}

void lcd_draw_string(uint16_t x, uint16_t y, const char *str,
                     uint16_t fg, uint16_t bg, uint8_t scale)
{
    uint16_t cx = x;
    while (*str) {
        lcd_draw_char(cx, y, *str, fg, bg, scale);
        cx += 6 * scale;
        str++;
    }
}

void lcd_draw_hline(uint16_t x, uint16_t y, uint16_t w, uint16_t color)
{
    lcd_fill_rect(x, y, w, 1, color);
}

void lcd_draw_vline(uint16_t x, uint16_t y, uint16_t h, uint16_t color)
{
    lcd_fill_rect(x, y, 1, h, color);
}

void lcd_flush(void)
{
    /* 用内部 DMA 缓冲区逐行发送，避免 PSRAM cache 一致性问题 */
    static uint8_t *s_dma_line;
    if (!s_dma_line) {
        s_dma_line = heap_caps_malloc(LCD_WIDTH * 2, MALLOC_CAP_DMA | MALLOC_CAP_INTERNAL);
        assert(s_dma_line);
    }

    lcd_set_window(0, 0, LCD_WIDTH - 1, LCD_HEIGHT - 1);
    for (int y = 0; y < LCD_HEIGHT; y++) {
        memcpy(s_dma_line, &s_fb[y * LCD_WIDTH], LCD_WIDTH * 2);
        lcd_data_buf(s_dma_line, LCD_WIDTH * 2);
    }
}
